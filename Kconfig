## Kconfig
```kconfig
# Sensor data simulator
#
# Copyright (c) 2019 Nordic Semiconductor
#
# SPDX-License-Identifier: LicenseRef-Nordic-5-Clause
#

menuconfig ANALOG_INPUT
	bool "ANALOG_INPUT adc sensor"
  select ADC
	help
	  Enable ANALOG_INPUT adc sensor.

if ANALOG_INPUT

config ANALOG_INPUT_WORKQUEUE_PRIORITY
    int "Workqueue priority"
    default 10
    help
      Priority of thread used by the workqueue

config ANALOG_INPUT_WORKQUEUE_STACK_SIZE
    int "Workqueue stack size"
    default 1024
    help
      Stack size of thread used by the workqueue

config ANALOG_INPUT_REPORT_INTERVAL_MIN
	int "ANALOG_INPUT's default minimum report rate"
	default 0
	help
	  Default minimum report interval in milliseconds.
		Slow down input reporting for hid queue over the air.

config ANALOG_INPUT_LOG_DBG_RAW
	bool "ANALOG_INPUT debug log for RAW mV"

config ANALOG_INPUT_LOG_DBG_REPORT
	bool "ANALOG_INPUT debug log for REPORT value"


config ANALOG_INPUT_ERROR_THRESHOLD
    int "Number of consecutive errors before reset"
    default 3
    help
      Number of consecutive sampling errors before triggering an ADC reset

config ANALOG_INPUT_WATCHDOG_TIMEOUT_MS
    int "Watchdog timeout in milliseconds"
    default 1000
    help
      Time without successful readings before considering the ADC stuck



module = ANALOG_INPUT
module-str = ANALOG_INPUT
source "${ZEPHYR_BASE}/subsys/logging/Kconfig.template.log_config"

endif #ANALOG_INPUT
```
